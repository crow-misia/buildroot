## package/bazel/Config.in.host
```kconfig
config BR2_PACKAGE_HOST_BAZEL
	bool "host bazel"
	depends on BR2_HOST_GCC_AT_LEAST_4_7
	help
	  This package will build the compiler for the host as well as
	  two flavors of the standard library: one for the host, another
	  for the target. Both are installed in the host directory.
```

## package/ca-certificates/Config.in.host
```kconfig
config BR2_PACKAGE_HOST_CA_CERTIFICATES
	bool "host CA Certificates"
	help
	  This package includes PEM files of CA certificates to allow
	  SSL-based applications to check for the authenticity of SSL
	  connections.

	  It includes, among others, certificate authorities used by the
	  Debian infrastructure and those shipped with Mozilla's
	  browsers.

	  https://salsa.debian.org/debian/ca-certificates
```

## package/cli11/Config.in
```kconfig
config BR2_PACKAGE_CLI11
	bool "cli11"
	help
	  CLI11 is a command line parser for C++11 and beyond that provides
	  a rich feature set with a simple and intuitive interface.
```

## package/cpr/Config.in
```kconfig
config BR2_PACKAGE_CPR
	bool "cpr"
	depends on BR2_TOOLCHAIN_HAS_THREADS
	select BR2_PACKAGE_LIBCURL
	help
	  C++ Requests is a simple wrapper around libcurl inspired by the excellent Python Requests project.
```

## package/depot-tools/Config.in.host
```kconfig
config BR2_PACKAGE_HOST_DEPOT_TOOLS
	bool "host depot_tools"
	select BR2_PACKAGE_HOST_PYTHON
	select BR2_PACKAGE_HOST_PYTHON_SSL
	help
	  depot_tools - A collection of tools for dealing with Chromium development.
```

## package/go-tflite/Config.in
```kconfig
config BR2_PACKAGE_GO_TFLITE
	bool "go-tflite"
	default false
	depends on BR2_PACKAGE_HOST_GO_TARGET_ARCH_SUPPORTS
	select BR2_PACKAGE_TENSORFLOW_LITE
```

## package/hts-engine/Config.in
```kconfig
config BR2_PACKAGE_HTS_ENGINE
	bool "hts-engine"
	help
	  HTS Engine

	  http://hts-engine.sourceforge.net/
```

## package/hts-voice-mmdagent/Config.in
```kconfig
config BR2_PACKAGE_HTS_VOICE_MMDAGENT
	bool "hts-voice-mmdagent"
	depends on BR2_PACKAGE_HTS_ENGINE
	default y

config BR2_PACKAGE_HTS_VOICE_MMDAGENT_MEI
	bool
	default n

config BR2_PACKAGE_HTS_VOICE_MMDAGENT_TAKUMI
	bool
	default n

if BR2_PACKAGE_HTS_VOICE_MMDAGENT

config BR2_PACKAGE_HTS_VOICE_MMDAGENT_MEI_ANGRY
	bool "hts-voice-mmdagent-mei-angry"
	select BR2_PACKAGE_HTS_VOICE_MMDAGENT_MEI
	default y

config BR2_PACKAGE_HTS_VOICE_MMDAGENT_MEI_BASHFUL
	bool "hts-voice-mmdagent-mei-bashful"
	select BR2_PACKAGE_HTS_VOICE_MMDAGENT_MEI
	default y

config BR2_PACKAGE_HTS_VOICE_MMDAGENT_MEI_HAPPY
	bool "hts-voice-mmdagent-mei-happy"
	select BR2_PACKAGE_HTS_VOICE_MMDAGENT_MEI
	default y

config BR2_PACKAGE_HTS_VOICE_MMDAGENT_MEI_NORMAL
	bool "hts-voice-mmdagent-mei-normal"
	select BR2_PACKAGE_HTS_VOICE_MMDAGENT_MEI
	default y

config BR2_PACKAGE_HTS_VOICE_MMDAGENT_MEI_SAD
	bool "hts-voice-mmdagent-mei-sad"
	select BR2_PACKAGE_HTS_VOICE_MMDAGENT_MEI
	default y

config BR2_PACKAGE_HTS_VOICE_MMDAGENT_TAKUMI_ANGRY
	bool "hts-voice-mmdagent-takumi-angry"
	select BR2_PACKAGE_HTS_VOICE_MMDAGENT_TAKUMI
	default y

config BR2_PACKAGE_HTS_VOICE_MMDAGENT_TAKUMI_HAPPY
	bool "hts-voice-mmdagent-takumi-happy"
	select BR2_PACKAGE_HTS_VOICE_MMDAGENT_TAKUMI
	default y

config BR2_PACKAGE_HTS_VOICE_MMDAGENT_TAKUMI_NORMAL
	bool "hts-voice-mmdagent-takumi-normal"
	select BR2_PACKAGE_HTS_VOICE_MMDAGENT_TAKUMI
	default y

config BR2_PACKAGE_HTS_VOICE_MMDAGENT_TAKUMI_SAD
	bool "hts-voice-mmdagent-takumi-sad"
	select BR2_PACKAGE_HTS_VOICE_MMDAGENT_TAKUMI
	default y

endif
```

## package/hts-voice-nitech/Config.in
```kconfig
config BR2_PACKAGE_HTS_VOICE_NITECH
	bool "hts-voice-nitech"
	depends on BR2_PACKAGE_HTS_ENGINE
	default y
```

## package/libmediasoupclient/Config.in
```kconfig
config BR2_PACKAGE_LIBMEDIASOUPCLIENT
	bool "libmediasoupclient"
	depends on BR2_TOOLCHAIN_HAS_THREADS
	select BR2_PACKAGE_LIBWEBRTC
	select BR2_PACKAGE_LIBSDPTRANSFORM
	help
	  C++ client side library for building mediasoup based applications built on top of Google's libwebrtc C++ library
```

## package/libsdptransform/Config.in
```kconfig
config BR2_PACKAGE_LIBSDPTRANSFORM
	bool "libsdptransform"
	depends on BR2_TOOLCHAIN_HAS_THREADS
	select BR2_PACKAGE_JSON_FOR_MODERN_CPP
	help
	  C++ version of the sdp-transform JavaScript library exposing the same API
```

## package/libsoundio/Config.in
```kconfig
config BR2_PACKAGE_LIBSOUNDIO
	bool "libsoundio"
	help
          C library providing cross-platform audio input and output.
	  The API is suitable for real-time software such as digital audio workstations as well as consumer software such as music players.

	  http://libsound.io/
```

## package/libwebrtc/Config.in
```kconfig
config BR2_PACKAGE_LIBWEBRTC
	bool "libwebrtc"
	depends on BR2_USE_WCHAR
	depends on BR2_TOOLCHAIN_HAS_THREADS
	depends on !BR2_STATIC_LIBS
	depends on BR2_USE_MMU # fork()
	help
	  WebRTC is a free, open project that provides browsers and mobile applications with Real-Time Communications (RTC) capabilities via simple APIs. The WebRTC components have been optimized to best serve this purpose.

	  https://webrtc.org/
```

## package/mediasoup-broadcaster-demo/Config.in
```kconfig
config BR2_PACKAGE_MEDIASOUP_BROADCASTER_DEMO
	bool "mediasoup-broadcaster-demo"
	depends on BR2_TOOLCHAIN_HAS_THREADS
	select BR2_PACKAGE_LIBMEDIASOUPCLIENT
	select BR2_PACKAGE_CPR
	select BR2_PACKAGE_LIBCURL
	select BR2_PACKAGE_JSON_FOR_MODERN_CPP
	help
	  C++ client side library for building mediasoup based applications built on top of Google's libwebrtc C++ library
```

## package/momo/Config.in
```kconfig
menuconfig BR2_PACKAGE_MOMO
	bool "momo"
	depends on BR2_TOOLCHAIN_HAS_THREADS
	select BR2_PACKAGE_BOOST
	select BR2_PACKAGE_BOOST_FILESYSTEM
	select BR2_PACKAGE_BOOST_SYSTEM
	select BR2_PACKAGE_CLI11
	select BR2_PACKAGE_JSON_FOR_MODERN_CPP
	select BR2_PACKAGE_LIBWEBRTC
	help
	  WebRTC Native Client Momo

	  https://github.com/shiguredo/momo

if BR2_PACKAGE_MOMO

config BR2_PACKAGE_MOMO_USE_SDL2
	bool "momo-use-sdl2"
	default y
	select BR2_PACKAGE_SDL2
	help
	  use SDL2

config BR2_PACKAGE_MOMO_USE_GOOGLE_STUN_SERVER
	bool "momo-use-google-stun-server"
	default y
	help
	  use Google STUN Server

endif
```

## package/nats-server/Config.in
```kconfig
config BR2_PACKAGE_NATS_SERVER
	bool "nats-server"
	default false
	depends on BR2_PACKAGE_HOST_GO_TARGET_ARCH_SUPPORTS
	help
		High-Performance server for NATS, the cloud native messaging system.
```

## package/node-prune/Config.in.host
```kconfig
config BR2_PACKAGE_HOST_NODE_PRUNE
	bool "host node-prune"
	default true
	depends on BR2_PACKAGE_HOST_GO_ARCH_SUPPORTS
	depends on BR2_PACKAGE_HOST_GO_CGO_LINKING_SUPPORTS
	depends on BR2_PACKAGE_NODEJS
	help
		node-prune is a small tool to prune unnecessary files from ./node_modules, such as markdown,
		typescript source files, and so on. Primarily built for Up which lets you deploy serverless web applications in seconds.
```

## package/open-jtalk/Config.in
```kconfig
config BR2_PACKAGE_OPEN_JTALK
	bool "open-jtalk"
	select BR2_PACKAGE_HTS_ENGINE
	help
	  Open JTalk

	  http://open-jtalk.sourceforge.net/
```

## package/python-numpy/python3-numpy/Config.in.host
```kconfig
config BR2_PACKAGE_HOST_PYTHON3_NUMPY
	bool "host python3-numpy"
	depends on BR2_PACKAGE_HOST_PYTHON3
	help
	  NumPy is the fundamental package for scientific computing
	  with Python.

	  Note that NumPy needs fenv.h fully supported by the
	  C library.

	  http://www.numpy.org/
```

## package/tensorflow-lite/Config.in
```kconfig
config BR2_PACKAGE_TENSORFLOW_LITE
	bool "tensorflow-lite" 
	depends on BR2_TOOLCHAIN_GCC_AT_LEAST_4_9 # C++11
	select BR2_HOST_PYTHON_NUMPY
	select BR2_PACKAGE_ZLIB
	help
          TensorFlow Lite is the official solution for running
          machine learning models on mobile and embedded devices.
          It enables on-device machine learning inference with
          low latency and a small binary size on Android, iOS,
          and other operating systems.

	  https://www.tensorflow.org/lite/
```
